## config/boards/arm/nice_nano/Kconfig.board
```kconfig
# nice!nano board configuration

# Copyright (c) 2020 Pete Johanson
# SPDX-License-Identifier: MIT

config BOARD_NICE_NANO_V3
    bool "nice!nano v3"
    depends on SOC_NRF52840_QIAA
```

## config/boards/arm/shinomiya65/Kconfig.board
```kconfig
# Shinomiya65 board configuration

# Copyright (c) 2020 Pete Johanson
# SPDX-License-Identifier: MIT

config BOARD_SHINOMIYA65
    bool "shinomiya65"
    depends on SOC_NRF52840_QIAA
```

## config/boards/arm/shinomiya65/Kconfig.defconfig
```kconfig
# Copyright (c) 2021 The ZMK Contributors
# SPDX-License-Identifier: MIT

if BOARD_SHINOMIYA65

config BOARD
    default "Shinomiya 65"

if USB_DEVICE_STACK

config USB_NRFX
    default y

endif # USB_DEVICE_STACK

config BT_CTLR
    default BT

config ZMK_BLE
    default y

config ZMK_USB
    default y

config BT
    default y

config BT_MAX_CONN
    default 1

config BT_MAX_PAIRED
    default 1

config ZMK_BLE_CLEAR_BONDS_ON_START
    default y

endif # BOARD_SHINOMIYA65
```
